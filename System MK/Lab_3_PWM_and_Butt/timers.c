#include "timers.h"
#include "INDIKATE.h"

//// Настройка и управлением таймером 1 для управления преобразователем
/// работает в режиме FAST_PWM 
/// TOP - в регистре ICR  сравнение в OCR1A
void Init_TimerT1(void)
{
  /// установим режим работы вывода ОС1А 
  /// и вид ШИМ
   TCCR1A = (1<<COM1A1)|(0<<COM1A0) /// режим работы выхода OC1A
             /// сброс ОС1А при досижении сравнения
          | (0<<WGM10)|(1<<WGM11);
   TCCR1B = (1<<WGM13)|(1<<WGM12);  /// режим fast PWM 
   /// предельное значение ШИМ
   ICR1   = PWM_TOP_VAL;   /// TOP - до чего считаем
   OCR1A  = 0;             /// значение ШИМ - 0
   TCNT1  = 0;
   TCCR1B |= (1<<CS10);    /// запустили таймер   
}
/// доступны функции включить/выключить преобразователь 
///#define TURN_OFF_HI_VOLT  TCCR1B &= ~(7<<CS10);   TCNT1 = 0;          

//// Настройка и управление таймером 0 для отсчета заданного 
//// временного интервала
/// ф установка и запуск таймера на заданное время

///////////////////////////////
/// макросы для управления полевиком и симистором
#define MOSFET_ON_ChargeCAP PORTB |= (1<<PB0);
#define MOSFET_OFF          PORTB &= ~(1<<PB0);
#define TRIAK_ON_IGNITION   PORTC |= ((1<<PC2)|(1<<PC3));
#define TRIAK_OFF           PORTC &= ~((1<<PC2)|(1<<PC3));

///////////////////////////////
/// настрока на работу таймера 0 и прерывания INT0
/// и портов управления симистора и полевика
void Init_Timer0_and_PORTS(void)
{
  /// настрока портов
  /// PB0 - управление полевиком
  /// PB1 - управление преобразователем
  PORTB &= ~((1<<PB1)|(1<<PB0));  /// выключим транзистор преобразователя
  DDRB |= (1<<PB0)|(1<<PB1);      /// настроим направление ВЫХОД
  /// PС2, PС3 - управление симистором
  TRIAK_OFF;
  DDRC |= ((1<<PC2)|(1<<PC3));
  PORTC &= ~(1<<PC0);  /// отключена подтяжка н измерительном канале
  /// настроим прерывания от INT0
  ///The rising edge of INT0 generates an interrupt request.
  MCUCR |= (1<<ISC01)|(1<<ISC00);
  GICR  |= (1<<INT0);  /// разрешили прерывания от INT0
  
  Stop_T0;             /// сброс таймера 0
  TCNT0 = 0;
}

/// Определим время паузы после искры
/// запускаем таймер на чатоте карц/64 
/// и время искры 300 мкс
#define _TIME_400mks   0xCE
#define _TIME_600mks   0xB6
/// время паузы 600 мкс
#define _TIME_800mks   0x9C
/// время для разрешения повторного импульса 2ms
#define _TIME_1ms       0x80
#define _TIME_2ms       0x00


/// указатель на ф - обработчик события переполнение таймера 0
FPTR_vv   Timer0_Checker;
/// Эти функции выполняем по указателю Timer0_Checker
/// будет две ф которые мы выполняем

/// прерывание INT0 начинается формирование искры...
#pragma vector = INT0_vect
__interrupt void ON_Start_Ignition(void)
{
  TRIAK_ON_IGNITION;  /// включим симистор
  GICR &= ~(1<<INT0);  /// запретим прерывания от INT0
  /// установим обработчик для таймера 0 - Timer0_Checker
  Timer0_Checker = &ON_End_Ignition_Time;   
  Stop_T0;            /// сброс флага таймера и останов
  /// запускаем таймер 0 на формирование интервала искры
  Start_T0(_TIME_600mks);
}

/// 1 - отработали время зажигания ...
void ON_End_Ignition_Time(void)
{
/// если таймер не отработал - выходим
  if((TIFR&(1<<TOV0)) == 0) return;
  Stop_T0;              /// сброс флага таймера и останов
  TRIAK_OFF;   /// закрываем симистор
/// запускаем таймер установим обработчик 2
  Timer0_Checker = &ON_End_PAUSE_Time;   
/// загружаем время на закрытие симстора
  Start_T0(_TIME_400mks);
}

/// 2 - отработана пауза после закрытия симистора
/// Заряжаем емкость
/// для выьранной RC цепочки 3RC = 0,8мс за 2мс зарядится!!!!
void ON_End_PAUSE_Time(void)
{
/// если таймер не отработал - выходим
  if((TIFR&(1<<TOV0)) == 0) return;
  Stop_T0;              /// сброс флага таймера и останов
/// открываем полевик - и заряжаем емкость
  MOSFET_ON_ChargeCAP;
  Timer0_Checker = &ON_End_PAUSE_2NEW_PULSE;   
/// загружаем время на заряд емкости
  Start_T0(_TIME_2ms);
}

/// 3 - разрешение прерываний от INT0
/// для ограничения частоты входящих импульсов
void ON_End_PAUSE_2NEW_PULSE(void)
{
/// если таймер не отработал - выходим
  if((TIFR&(1<<TOV0)) == 0) return;
  Stop_T0;              /// сброс флага таймера и останов
  /// прошло 2 мс запустимся на 400мкс - защитный интервал
  /// для включ. симистора
  MOSFET_OFF;   /// 1 выключим транзистор заряда !!!!!!
  Start_T0(_TIME_400mks);
  Timer0_Checker = &ON_ENABLE_NEW_PULSE;   
}

/// 4 - сформировали импульс жажигания, паузу, зарядный импульс
/// защитный интервал, теперь, разрешим новый импульс
void ON_ENABLE_NEW_PULSE(void)
{
  Timer0_Checker = 0; /// сброс обработчика таймера в 0
  GIFR = 1<<INTF0;    /// сбросим флаг от INT0
  GICR |= (1<<INT0);  /// разрешим прерывания от INT0
}


/// конец 
/***********************************************************************/


