#include "SHow_FUN.h"
#include "Timer_2_CNTRL.h"
#include "INDIKATE.h"
#include "Kbrd.h"
#include "timer1.h"

void main( void )
{
 /// переменная счетчик тиков по 100мкс
 u_int tick_cntr = 0;
 u_char ctmp;
  ///////////////////////////
  /// Предварительная настройка портов
  /// работаем с МК 1 к котрому прицеплены ЦАП и ключ силовой
  /// готовит порт для индикации результата Бит PB0 PORTB
  show_init();
  /// настройка таймера 2 на генерацию временного интервала
  /// на опрос кнопок будет достаточно 20мс интервала
  Timer2_INIT();
  Timer2_START();  //// запуск таймера
  /// процедура настройка индикация режим работы
  InitIndikate();
  /// ф установить режим индикации как будет гореть LED
  /// для установвки другого режима индикации - один из
  /// определенных === /// режим индикации светодиода
  Set_INDIK_VAL(LED_1SHORT);
  //// Настройка и управлением таймером 1
  /// работает в режиме FAST_PWM
  /// TOP - в регистре ICR  сравнение в OCR1A
  Init_TimerT1();

  ///////////////////////////
  /// основной цикл
  while(1){
     ////////////////////////////////////////////////////////
     /// обработка таймера
     if(Timer2_CHECK()){/// каждые 100мкс
        tick_cntr++;    /// считаем 100мкс

        // процедура опроса кнопок вызываем 1 раз в 25 мс
        if((tick_cntr&0x00FF)== 0){
           ChkKbrd();
        }

        /// функция выводит на ножку значение 10бит
        /// что бы посмотреть его осциллографом
        show_result(OCR1A);
        //////////////////////////////////////////////
        if(tick_cntr>=1000){     /// каждые 100 мс
           tick_cntr = 0;        /// переустановим счетчик
           Indikate( );          /// процедура индикации текущего режима работы

           ctmp = GetPrsCode();
           if( ctmp == TWOKEYPRS ){ // нажали обе кнопки
              OCR1A = 0;/// сброс регистра в 0 - отключим ШИМ
           }else if( ctmp == LEFTSHORT ){ /// короткое нажатие SW1
              if(OCR1A)
                 OCR1A--;   /// уменьшим ШИМ точно на 1
           }else if( ctmp == RIGHTSHORT ){ /// короткое нажатие SW2
              if(OCR1A<PWM_TOP_VAL)
                 OCR1A++;   /// увеличим ШИМ точно на 1
           }else if( ctmp == LEFTLONG ){ /// длинное нажатие SW1
              if(OCR1A > 50)
                 OCR1A -= 50;   /// уменьшим ШИМ точно на 50
              else   /// если значение менее 50 ...
                 OCR1A = 0;
           }else if( ctmp == RIGHTLONG ){ /// длинное нажатие SW2
              if(OCR1A<(PWM_TOP_VAL-50))
                 OCR1A += 50;   /// увеличим ШИМ точно на 1
              else  /// если значение больше чем  PWM_TOP_VAL-50 ...
                 OCR1A = PWM_TOP_VAL-1;
           }


        }/// конец каждые 100 мс
        //////////////////////////////////////////////
     }/// КОНЕЦ обработка таймера каждые 100мкс
  }
}


